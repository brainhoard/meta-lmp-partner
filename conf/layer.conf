## conf/layer.conf
```bitbake
# We might have a conf and classes directory, append to BBPATH
BBPATH .= ":${LAYERDIR}"

# We have a recipes directory, add to BBFILES
BBFILES += " \
    ${LAYERDIR}/recipes*/*/*.bb \
    ${LAYERDIR}/recipes*/*/*.bbappend \
    "

BBFILE_COLLECTIONS += "lmp-partner"
BBFILE_PATTERN_lmp-partner := "^${LAYERDIR}/"
BBFILE_PRIORITY_lmp-partner = "12"

LAYERDEPENDS_lmp-partner = "core meta-lmp-bsp"
LAYERSERIES_COMPAT_lmp-partner = "kirkstone"

BBFILES_DYNAMIC += " \
    intel:${LAYERDIR}/dynamic-layers/intel/*/*/*.bb \
    intel:${LAYERDIR}/dynamic-layers/intel/*/*/*.bbappend \
    tegra:${LAYERDIR}/dynamic-layers/tegra/*/*/*.bb \
    tegra:${LAYERDIR}/dynamic-layers/tegra/*/*/*.bbappend \
"
```

## conf/machine/jetson-nano-devkit-emmc-sec.conf
```bitbake
#@TYPE: Machine
#@NAME: Nvidia Jetson Nano (eMMC)
#@DESCRIPTION: Nvidia Jetson Nano dev board with eMMC module

require conf/machine/jetson-nano-devkit-emmc.conf

# MACHINEOVERRIDES =. "nano-sec:"

TEGRA_SIGNING_ARGS ?= ""
TEGRA_SIGNING_ENV ?= ""
TEGRA_SIGNING_EXCLUDE_TOOLS ?= ""
TEGRA_SIGNING_EXTRA_DEPS ?= ""

# UBOOT_BOOTIMG_BOARD ?= "/dev/mmcblk0p1"
# KERNEL_ROOTSPEC ?= "root=/dev/mmcblk0p${distro_bootpart} rw rootwait"
# platform-preboot-cboot.sh:      rootdev="/dev/mmcblk0p1"
```

## meta-partner-base/conf/layer.conf
```bitbake
# We might have a conf and classes directory, append to BBPATH
BBPATH .= ":${LAYERDIR}"

# We have a recipes directory, add to BBFILES
BBFILES += "${LAYERDIR}/recipes*/*/*.bb ${LAYERDIR}/recipes*/*/*.bbappend"

BBFILE_COLLECTIONS += "lmp-partner-base"
BBFILE_PATTERN_lmp-partner-base := "^${LAYERDIR}/"
BBFILE_PRIORITY_lmp-partner-base = "9"

LAYERDEPENDS_lmp-partner-base = "core meta-lmp-base"
LAYERSERIES_COMPAT_lmp-partner-base = "kirkstone"

BBFILES_DYNAMIC += " \
    clang-layer:${LAYERDIR}/dynamic-layers/clang/*/*/*.bb \
    clang-layer:${LAYERDIR}/dynamic-layers/clang/*/*/*.bbappend \
"
```

## meta-partner-bsp/conf/layer.conf
```bitbake
# We might have a conf and classes directory, append to BBPATH
BBPATH .= ":${LAYERDIR}"

# We have a recipes directory, add to BBFILES
BBFILES += "${LAYERDIR}/recipes*/*/*.bb ${LAYERDIR}/recipes*/*/*.bbappend"

BBFILE_COLLECTIONS += "lmp-partner-bsp"
BBFILE_PATTERN_lmp-partner-bsp := "^${LAYERDIR}/"
BBFILE_PRIORITY_lmp-partner-bsp = "9"

LAYERDEPENDS_lmp-partner-bsp = "core meta-lmp-bsp"
LAYERSERIES_COMPAT_lmp-partner-bsp = "kirkstone"

BBFILES_DYNAMIC += " \
    intel:${LAYERDIR}/dynamic-layers/intel/*/*/*.bb \
    intel:${LAYERDIR}/dynamic-layers/intel/*/*/*.bbappend \
    tegra:${LAYERDIR}/dynamic-layers/tegra/*/*/*.bb \
    tegra:${LAYERDIR}/dynamic-layers/tegra/*/*/*.bbappend \
"
```

## meta-partner-bsp/conf/machine/jetson-nano-devkit-emmc-sec.conf
```bitbake
#@TYPE: Machine
#@NAME: Nvidia Jetson Nano (eMMC)
#@DESCRIPTION: Nvidia Jetson Nano dev board with eMMC module

require conf/machine/jetson-nano-devkit-emmc.conf

TEGRA_SIGNING_ARGS ?= ""
TEGRA_SIGNING_ENV ?= ""
TEGRA_SIGNING_EXCLUDE_TOOLS ?= ""
TEGRA_SIGNING_EXTRA_DEPS ?= ""
```

## meta-partner-bsp/conf/machine/jetson-nano-devkit-sec.conf
```bitbake
#@TYPE: Machine
#@NAME: Nvidia Jetson Nano
#@DESCRIPTION: Nvidia Jetson Nano dev board

require conf/machine/jetson-nano-devkit.conf

# devkit with sdcard not supported
TEGRA_SIGNING_ARGS = ""
TEGRA_SIGNING_ENV = ""
TEGRA_SIGNING_EXCLUDE_TOOLS = ""
TEGRA_SIGNING_EXTRA_DEPS = ""
```

## meta-partner-bsp/conf/machine/jetson-xavier-nx-devkit-emmc-sec.conf
```bitbake
#@TYPE: Machine
#@NAME: Nvidia Jetson Xavier NX dev kit - eMMC
#@DESCRIPTION: Nvidia Jetson Xavier NX development kit with QSPI+eMMC
#              module

require conf/machine/jetson-xavier-nx-devkit-emmc.conf

TEGRA_SIGNING_ARGS ?= ""
TEGRA_SIGNING_ENV ?= ""
TEGRA_SIGNING_EXCLUDE_TOOLS ?= ""
TEGRA_SIGNING_EXTRA_DEPS ?= ""
```

## meta-partner-bsp/conf/machine/jetson-xavier-nx-devkit-sec.conf
```bitbake
#@TYPE: Machine
#@NAME: Nvidia Jetson Xavier NX dev kit
#@DESCRIPTION: Nvidia Jetson Xavier NX development kit with
#              QSPI+SDcard module (SKU 0000)

require conf/machine/jetson-xavier-nx-devkit.conf

# devkit with sdcard not supported
TEGRA_SIGNING_ARGS = ""
TEGRA_SIGNING_ENV = ""
TEGRA_SIGNING_EXCLUDE_TOOLS = ""
TEGRA_SIGNING_EXTRA_DEPS = ""
```
